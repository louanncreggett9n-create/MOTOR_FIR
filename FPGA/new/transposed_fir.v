`timescale 1ns / 1ps
//////////////////////////////////////////////////////////////////////////////////
// Module Name: transposed_fir
// Description:
//     Parameterized transposed direct-form FIR filter.
//
//     - Coefficients are loaded from "fir_coefficients.vh" (generated by
//       gen_fir_coef.py). The default design is a 31-tap, 16-bit coefficient
//       low-pass filter with Fs = 100 Hz and Fc = 20 Hz.
//     - Coefficients are packed into a single vector COEFF and extracted with
//       Verilog-2001 part-select, so no SystemVerilog array assignment is needed.
//     - The filter advances its internal delay line only when valid_in is high,
//       so it can be driven by a down-sampled source such as DDS_Sampler.
//     - valid_out is a one-clock delayed copy of valid_in. The first TAP_NUM-1
//       outputs are startup transients based on zero padding; gate valid_out
//       externally if you prefer to discard them.
//     - The output is full-precision signed. To convert back to the same
//       integer scale as the input, right-shift by (COEF_W-1) and round.
//
// Example scaling:
//     With COEF_W = 16, coefficients are in Q15 format and sum to 32768.
//     data_out[DATA_OUT_W-1 : COEF_W-1] is the integer part.
//////////////////////////////////////////////////////////////////////////////////

module transposed_fir #(
    parameter TAP_NUM    = 31,                  // Number of taps; must match COEFF vector
    parameter DATA_IN_W  = 16,                  // Input data width (signed)
    parameter COEF_W     = 16,                  // Coefficient width (signed); must match COEFF
    parameter DATA_OUT_W = 40                   // Full-precision output width
)(
    input  wire                       clk,
    input  wire                       rst_n,
    input  wire                       valid_in,
    input  wire signed [DATA_IN_W-1:0] data_in,
    output reg                        valid_out,
    output reg  signed [DATA_OUT_W-1:0] data_out
);

    // Coefficient vector generated by Python script.
    // COEFF = {h[TAP_NUM-1], h[TAP_NUM-2], ..., h[0]}
    `include "fir_coefficients.vh"

    // Delay line registers hold partial sums between taps.
    // delay_line[0] is closest to the output, delay_line[TAP_NUM-2] is farthest.
    reg signed [DATA_OUT_W-1:0] delay_line [0:TAP_NUM-2];

    // Combinational multipliers: data_in * h[k]
    // Coefficients are extracted from the packed vector using Verilog-2001 part-select.
    wire signed [DATA_IN_W + COEF_W - 1:0] product [0:TAP_NUM-1];

    genvar g;
    generate
        for (g = 0; g < TAP_NUM; g = g + 1) begin : g_mul
            assign product[g] = data_in * $signed(COEFF[g * COEF_W +: COEF_W]);
        end
    endgenerate

    integer i;

    // -------------------------------------------------------------------------
    // Transposed FIR delay line: "multiply first, then add through delays".
    // The chain advances only when a new sample arrives (valid_in == 1).
    // All operands are signed, so Verilog sign-extends automatically.
    // -------------------------------------------------------------------------
    always @(posedge clk or negedge rst_n) begin
        if (!rst_n) begin
            for (i = 0; i < TAP_NUM-1; i = i + 1)
                delay_line[i] <= 'd0;
        end else if (valid_in) begin
            // Farthest tap: only the product, no incoming partial sum
            delay_line[TAP_NUM-2] <= product[TAP_NUM-1];
            // Intermediate taps: product + previous partial sum
            for (i = 0; i < TAP_NUM-2; i = i + 1)
                delay_line[i] <= product[i+1] + delay_line[i+1];
        end
    end

    // -------------------------------------------------------------------------
    // Output register: y[n] = h[0]*x[n] + delay_line[0]
    // -------------------------------------------------------------------------
    always @(posedge clk or negedge rst_n) begin
        if (!rst_n) begin
            data_out <= 'd0;
        end else if (valid_in) begin
            data_out <= product[0] + delay_line[0];
        end
    end

    // -------------------------------------------------------------------------
    // Valid output: one-clock delayed version of valid_in.
    // -------------------------------------------------------------------------
    always @(posedge clk or negedge rst_n) begin
        if (!rst_n) begin
            valid_out <= 1'b0;
        end else begin
            valid_out <= valid_in;
        end
    end

endmodule
